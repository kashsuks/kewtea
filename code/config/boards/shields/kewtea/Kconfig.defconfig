## code/config/boards/shields/kewtea/Kconfig.defconfig
```kconfig
if SHIELD_KEWTEA

config ZMK_KEYBOARD_NAME
    default "kewtea"

config ZMK_DISPLAY
    default y

config LV_FONT_MONTSERRAT_16
    default y

endif
```
